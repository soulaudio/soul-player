## applications/firmware/sdkconfig.defaults
```kconfig
# ESP32-S3 Configuration for Soul Player DAP

# Chip and CPU Configuration
CONFIG_IDF_TARGET="esp32s3"
CONFIG_IDF_TARGET_ESP32S3=y
CONFIG_ESP32S3_DEFAULT_CPU_FREQ_240=y

# Flash Configuration
CONFIG_ESPTOOLPY_FLASHSIZE_16MB=y
CONFIG_ESPTOOLPY_FLASHMODE_DIO=y
CONFIG_ESPTOOLPY_FLASHFREQ_80M=y

# PSRAM Configuration (ESP32-S3-WROOM-1 has 8MB PSRAM)
CONFIG_ESP32S3_SPIRAM_SUPPORT=y
CONFIG_SPIRAM_MODE_OCT=y
CONFIG_SPIRAM_SPEED_80M=y
CONFIG_SPIRAM_SIZE=8388608
CONFIG_SPIRAM_USE_MALLOC=y
CONFIG_SPIRAM_MALLOC_ALWAYSINTERNAL=16384

# Partition Table
CONFIG_PARTITION_TABLE_CUSTOM=y
CONFIG_PARTITION_TABLE_CUSTOM_FILENAME="partitions.csv"

# Serial Console (UART0 for logging)
CONFIG_ESP_CONSOLE_UART_DEFAULT=y
CONFIG_ESP_CONSOLE_UART_NUM=0
CONFIG_ESP_CONSOLE_UART_BAUDRATE=115200

# Logging
CONFIG_LOG_DEFAULT_LEVEL_INFO=y
CONFIG_LOG_MAXIMUM_LEVEL_VERBOSE=y
CONFIG_LOG_COLORS=y

# Task Watchdog
CONFIG_ESP_TASK_WDT=y
CONFIG_ESP_TASK_WDT_TIMEOUT_S=10
CONFIG_ESP_TASK_WDT_CHECK_IDLE_TASK_CPU0=y
CONFIG_ESP_TASK_WDT_CHECK_IDLE_TASK_CPU1=y

# Interrupt Watchdog
CONFIG_ESP_INT_WDT=y
CONFIG_ESP_INT_WDT_TIMEOUT_MS=300

# Power Management (for battery optimization)
CONFIG_PM_ENABLE=y
CONFIG_PM_DFS_INIT_AUTO=y

# FreeRTOS Configuration
CONFIG_FREERTOS_HZ=1000
CONFIG_FREERTOS_UNICORE=n
CONFIG_FREERTOS_USE_TICKLESS_IDLE=y

# Bluetooth Configuration (disabled by default, enable via feature flag)
CONFIG_BT_ENABLED=n
# CONFIG_BT_ENABLED=y
# CONFIG_BTDM_CTRL_MODE_BLE_ONLY=y
# CONFIG_BTDM_CTRL_MODE_BR_EDR_ONLY=n
# CONFIG_BTDM_CTRL_MODE_BTDM=n
# CONFIG_BT_BLUEDROID_ENABLED=y
# CONFIG_BT_BLE_ENABLED=y

# Wi-Fi Configuration (disabled by default)
CONFIG_ESP32_WIFI_ENABLED=n

# I2S Configuration
CONFIG_I2S_ENABLE_DEBUG_LOG=n
CONFIG_I2S_ISR_IRAM_SAFE=y

# SPI Configuration (for E-ink and SD card)
CONFIG_SPI_MASTER_ISR_IN_IRAM=y
CONFIG_SPI_SLAVE_ISR_IN_IRAM=y

# SDMMC Configuration (4-bit SD card interface)
CONFIG_SDMMC_HOST_ISR_HANDLER_IN_IRAM=y

# USB Serial JTAG (for debugging without external UART)
CONFIG_ESP_CONSOLE_USB_SERIAL_JTAG=n
CONFIG_ESP_CONSOLE_SECONDARY_USB_SERIAL_JTAG=y

# Memory Protection
CONFIG_ESP_SYSTEM_MEMPROT_FEATURE=y

# Stack Size Configuration
CONFIG_ESP_MAIN_TASK_STACK_SIZE=8192
CONFIG_ESP_SYSTEM_EVENT_TASK_STACK_SIZE=4096

# NVS (Non-Volatile Storage for settings)
CONFIG_NVS_ENCRYPTION=n

# FAT Filesystem Configuration (for SD card)
CONFIG_FATFS_CODEPAGE_850=y
CONFIG_FATFS_LFN_HEAP=y
CONFIG_FATFS_MAX_LFN=255
CONFIG_FATFS_API_ENCODING_UTF_8=y

# Compiler Optimizations
CONFIG_COMPILER_OPTIMIZATION_SIZE=y
CONFIG_COMPILER_OPTIMIZATION_ASSERTIONS_DISABLE=n

# Bootloader Configuration
CONFIG_BOOTLOADER_LOG_LEVEL_WARN=y
CONFIG_BOOTLOADER_SKIP_VALIDATE_IN_DEEP_SLEEP=y

# Application Rollback Support (for OTA)
CONFIG_BOOTLOADER_APP_ROLLBACK_ENABLE=y

# Security Features (for production)
# CONFIG_SECURE_BOOT=y
# CONFIG_SECURE_FLASH_ENC_ENABLED=y

# RTC Memory (for crash logging)
CONFIG_ESP32S3_RTC_CLK_SRC_INT_RC=y
CONFIG_ESP32S3_RTC_CLK_CAL_CYCLES=576

# Brown-out Detector (prevent corruption on low voltage)
CONFIG_ESP32S3_BROWNOUT_DET=y
CONFIG_ESP32S3_BROWNOUT_DET_LVL_SEL_7=y
```
